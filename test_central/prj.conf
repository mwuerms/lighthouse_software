## CMakeLists.txt
```
# SPDX-License-Identifier: Apache-2.0

cmake_minimum_required(VERSION 3.20.0)
find_package(Zephyr REQUIRED HINTS $ENV{ZEPHYR_BASE})
project(test_central)

target_sources(app PRIVATE
  src/main.c
  src/usb_uart.c
  src/timestamp.c
)

zephyr_library_include_directories(${ZEPHYR_BASE}/samples/bluetooth)
```

## prj.conf
```kconfig
CONFIG_BT=y
CONFIG_BT_CENTRAL=y
CONFIG_STDOUT_CONSOLE=y
CONFIG_USB_DEVICE_STACK=y
CONFIG_USB_DEVICE_PRODUCT="BLE Central CDC ACM Logger"
CONFIG_USB_DEVICE_PID=0x0001
CONFIG_LOG=y
CONFIG_USB_DRIVER_LOG_LEVEL_ERR=y
CONFIG_USB_DEVICE_LOG_LEVEL_ERR=y
CONFIG_UART_INTERRUPT_DRIVEN=y
CONFIG_UART_LINE_CTRL=y
CONFIG_USB_DEVICE_INITIALIZE_AT_BOOT=n
CONFIG_GPIO=y
CONFIG_COUNTER=y
```

## nrf52833dk_nrf52833.overlay
```dts
// To get started, press Ctrl+Space to bring up the completion menu and view the available nodes.

// You can also use the buttons in the sidebar to perform actions on nodes.
// Actions currently available include:

// * Enabling / disabling the node
// * Adding the bus to a bus
// * Removing the node
// * Connecting ADC channels

// For more help, browse the DeviceTree documentation at https://docs.zephyrproject.org/latest/guides/dts/index.html
// You can also visit the nRF DeviceTree extension documentation at https://nrfconnect.github.io/vscode-nrf-connect/devicetree/nrfdevicetree.html
/*
 * Copyright (c) 2021 Nordic Semiconductor ASA
 *
 * SPDX-License-Identifier: Apache-2.0
 */

 &zephyr_udc0 {
	cdc_acm_uart0 {
		compatible = "zephyr,cdc-acm-uart";
	};
};
&rtc0 {
	status = "okay";
};
```

## nrf52840dongle_nrf52840.overlay
```dts
// To get started, press Ctrl+Space to bring up the completion menu and view the available nodes.

// You can also use the buttons in the sidebar to perform actions on nodes.
// Actions currently available include:

// * Enabling / disabling the node
// * Adding the bus to a bus
// * Removing the node
// * Connecting ADC channels

// For more help, browse the DeviceTree documentation at https://docs.zephyrproject.org/latest/guides/dts/index.html
// You can also visit the nRF DeviceTree extension documentation at https://nrfconnect.github.io/vscode-nrf-connect/devicetree/nrfdevicetree.html
/*
 * Copyright (c) 2021 Nordic Semiconductor ASA
 *
 * SPDX-License-Identifier: Apache-2.0
 */

 &zephyr_udc0 {
	cdc_acm_uart0 {
		compatible = "zephyr,cdc-acm-uart";
	};
};
```

## src/main.c
```c
/* main.c - Application main entry point */

/*
 * Copyright (c) 2015-2016 Intel Corporation
 *
 * SPDX-License-Identifier: Apache-2.0
 */

#include <zephyr/types.h>
#include <stddef.h>
#include <errno.h>
#include <zephyr/kernel.h>
#include <zephyr/sys/printk.h>

#include <zephyr/bluetooth/bluetooth.h>
#include <zephyr/bluetooth/hci.h>
#include <zephyr/bluetooth/conn.h>
#include <zephyr/bluetooth/uuid.h>
#include <zephyr/bluetooth/gatt.h>
#include <zephyr/sys/byteorder.h>

#include "usb_uart.h"
#include "timestamp.h"
#include "buoy_adv_data.h"

static void start_scan(void);

static struct bt_conn *default_conn;

// Adv_data: 0E:25:70:67:35:05 (random), rssi: -37, adv_data (hex, 25):0C0962756F795F626561636F6E0BFF0901CDABD2040100E40C
/*
0C (0C-1 = 0B)
09
62756F795F626561636F6E

0BFF0901CDABD2040100E40C
*/
#define BUOY_BEACON_DEVICE_NAME "buoy_beacon"
static const char buoy_bt_data_name_complete[] = BUOY_BEACON_DEVICE_NAME;
static int16_t filter_buoy_adv_data(struct net_buf_simple *ad) {
	uint8_t *adv_data = ad->data;
	uint8_t len, type, n, filter_res;
	// sanity checks
	if (ad == NULL) {
		// error
		return 0;
	}
	if (ad->len < strlen(buoy_bt_data_name_complete)) {
		// error, too short
		return 0;
	}
	// looking for BT_DATA_NAME_COMPLETE, buoy_bt_data_name_complete
	filter_res = 0;
	len = adv_data[0];
	type = adv_data[1];
	if (len == 0x0C) {
		if (type == BT_DATA_NAME_COMPLETE) {
			for(n = 0; n < (len-1); n++) {
				if(adv_data[2+n] == buoy_bt_data_name_complete[n]) {
					filter_res = 1;
				}
				else {
					filter_res = 0;
					break;
				}
			}
		}
	}
	if (filter_res == 0) {
		// error, buoy_bt_data_name_complete not found
		return 0;
	}
	return 1; // OK
}

static void device_found(const bt_addr_le_t *addr, int8_t rssi, uint8_t type,
			 struct net_buf_simple *ad)
{
	char addr_str[BT_ADDR_LE_STR_LEN];
	int err;

	if (default_conn) {
		return;
	}

	/* We're only interested in connectable events * /
	if (type != BT_GAP_ADV_TYPE_ADV_IND &&
	    type != BT_GAP_ADV_TYPE_ADV_DIRECT_IND) {
		return;
	}*/

	if(filter_buoy_adv_data(ad) == 0) {
		// not my data, continue looking
		return;
	}

	bt_addr_le_to_str(addr, addr_str, sizeof(addr_str));
	printk("Device found: %s (RSSI %d)\n", addr_str, rssi);

	//usb_uart_print_adv_data("Adv_data: ", addr_str, rssi, ad->data, ad->len);
	uint32_t now_s, now_ms;
	timestamp_get_counter(&now_s, &now_ms);
	usb_uart_print_adv_data_timestamp(now_s, now_ms, "Adv_data: ", addr_str, rssi, ad->data, ad->len);
}

static void start_scan(void)
{
	int err;

	/* This demo doesn't require active scan */
	err = bt_le_scan_start(BT_LE_SCAN_PASSIVE, device_found);
	//err = bt_le_scan_start(BT_LE_SCAN_ACTIVE, device_found);
	if (err) {
		printk("Scanning failed to start (err %d)\n", err);
		return;
	}

	printk("Scanning successfully started\n");
}

static void connected(struct bt_conn *conn, uint8_t err)
{
	char addr[BT_ADDR_LE_STR_LEN];

	bt_addr_le_to_str(bt_conn_get_dst(conn), addr, sizeof(addr));

	if (err) {
		printk("Failed to connect to %s (%u)\n", addr, err);

		bt_conn_unref(default_conn);
		default_conn = NULL;

		start_scan();
		return;
	}

	if (conn != default_conn) {
		return;
	}

	printk("Connected: %s\n", addr);

	bt_conn_disconnect(conn, BT_HCI_ERR_REMOTE_USER_TERM_CONN);
}

static void disconnected(struct bt_conn *conn, uint8_t reason)
{
	char addr[BT_ADDR_LE_STR_LEN];

	if (conn != default_conn) {
		return;
	}

	bt_addr_le_to_str(bt_conn_get_dst(conn), addr, sizeof(addr));

	printk("Disconnected: %s (reason 0x%02x)\n", addr, reason);

	bt_conn_unref(default_conn);
	default_conn = NULL;

	start_scan();
}

BT_CONN_CB_DEFINE(conn_callbacks) = {
	.connected = connected,
	.disconnected = disconnected,
};

int main(void)
{
	int err;
	
	usb_uart_start();
	usb_uart_print_message("this is test_central, looking for buoy adv data, filter and print\n");
	//usb_uart_print_message(model);
	usb_uart_print_message("\n\n");

	timestamp_start_counter();
	//usb_uart_print_data_types();

	err = bt_enable(NULL);
	if (err) {
		printk("Bluetooth init failed (err %d)\n", err);
		return 0;
	}

	printk("Bluetooth initialized\n");

	start_scan();
	return 0;
}
```

## src/buoy_adv_data.h
```c
/**
 * Martin Egli
 * 2024-03-27
 * buoy data advertising data module
 */
#ifndef _BUOY_ADV_DATA_H_
#define _BUOY_ADV_DATA_H_

#include <stdint.h>

// __packed__ ?
#define BUOY_ADV_DATA_VERSION_01_LENGTH (9)
#define BUOY_ADV_DATA_VERSION_01 (0x01)
struct buoy_adv_data_version_01_struct {
	uint8_t length;
	uint8_t version;
	uint16_t serial_number;
	uint16_t interrupt_counter;
	uint16_t input_states;
	uint16_t vbat_mV;
};

#endif // _BUOY_ADV_DATA_H_
```

## src/timestamp.c
```c
/**
 * Martin Egli
 * 2024-03-29
 * module timestamp
 * using sample alarm using RTC
 */
#include <stdint.h>
#include <zephyr/kernel.h>

#include <zephyr/device.h>
#include <zephyr/drivers/counter.h>

#define DELAY 2000000
#define ALARM_CHANNEL_ID 0

struct counter_alarm_cfg alarm_cfg;

#if defined(CONFIG_COUNTER_NRF_RTC)
#define TIMER DT_NODELABEL(rtc0)
#else
#error rtc0 not defined, check device tree overlay
#endif

static const struct device *const counter_dev = DEVICE_DT_GET(TIMER);

void timestamp_start_counter(void) {
    counter_start(counter_dev);
}

void timestamp_stop_counter(void) {
    counter_stop(counter_dev);
}

void timestamp_get_counter(uint32_t *now_s, uint32_t *now_ms) {
    uint32_t now_ticks;
	uint64_t now_usec;
	int now_sec, err;

    err = counter_get_value(counter_dev, &now_ticks);
	if (err) {
		printk("Failed to read counter value (err %d)", err);
		return;
	}

	now_usec = counter_ticks_to_us(counter_dev, now_ticks);
	now_sec = (int)(now_usec / USEC_PER_SEC);
	now_usec -= now_sec * USEC_PER_SEC;

	*now_s  = (uint32_t)now_sec;
	*now_ms = (uint32_t)(now_usec/1000);
}
```

## src/timestamp.h
```c
/**
 * Martin Egli
 * 2024-03-29
 * module timestamp
 */

#ifndef _TIMESTAMP_h_
#define _TIMESTAMP_h_

#include <stdint.h>

void timestamp_start_counter(void);
void timestamp_stop_counter(void);
void timestamp_get_counter(uint32_t *now_s, uint32_t *now_ms);

#endif // _TIMESTAMP_h_
```

## src/usb_uart.c
```c
/**
 * Martin Egli
 * 2024-03-24
 * usb uart module
 */

#include <stdio.h>
#include <string.h>
#include <zephyr/kernel.h>
#include <zephyr/device.h>
//#include <zephyr/drivers/gpio.h>
#include <zephyr/drivers/uart.h>

#include <zephyr/usb/usb_device.h>
#include <zephyr/usb/usbd.h>
#include <zephyr/sys/ring_buffer.h>

#include "usb_uart.h"

// do NOT use printk
//#include <zephyr/sys/printk.h>
#define printk(...)

// - private functions --------------------------------------
const struct device *usb_uart_dev;

#define RING_BUF_SIZE (1024UL*2)
uint8_t ring_buffer[RING_BUF_SIZE];

struct ring_buf ringbuf;

#define USB_UART_TEMP_STR_BUFFER_SIZE	(64)
static char usb_uart_temp_str_buffer[USB_UART_TEMP_STR_BUFFER_SIZE];

static void interrupt_handler(const struct device *dev, void *user_data)
{
	ARG_UNUSED(user_data);

	while (uart_irq_update(dev) && uart_irq_is_pending(dev)) {
		if (uart_irq_rx_ready(dev)) {
			int recv_len, rb_len;
			uint8_t buffer[64];
			size_t len = MIN(ring_buf_space_get(&ringbuf),
					 sizeof(buffer));

			recv_len = uart_fifo_read(dev, buffer, len);
			if (recv_len < 0) {
				printk("Failed to read UART FIFO");
				recv_len = 0;
			};

			rb_len = ring_buf_put(&ringbuf, buffer, recv_len);
			if (rb_len < recv_len) {
				printk("Drop %u bytes", recv_len - rb_len);
			}

			printk("tty fifo -> ringbuf %d bytes", rb_len);
			if (rb_len) {
				uart_irq_tx_enable(dev);
			}
		}

		if (uart_irq_tx_ready(dev)) {
			uint8_t buffer[64];
			int rb_len, send_len;

			rb_len = ring_buf_get(&ringbuf, buffer, sizeof(buffer));
			if (!rb_len) {
				printk("Ring buffer empty, disable TX IRQ");
				uart_irq_tx_disable(dev);
				continue;
			}

			send_len = uart_fifo_fill(dev, buffer, rb_len);
			if (send_len < rb_len) {
				printk("Drop %d bytes", rb_len - send_len);
			}

			printk("ringbuf -> tty fifo %d bytes", send_len);
		}
	}
}

// - public functions ---------------------------------------

void usb_uart_start(void) {
	uint32_t baudrate = 0U;
	int ret;

	usb_uart_dev = DEVICE_DT_GET_ONE(zephyr_cdc_acm_uart);
	if (!device_is_ready(usb_uart_dev)) {
		printk("CDC ACM device not ready");
		return;
	}

    ret = usb_enable(NULL);
	if (ret != 0) {
		printk("Failed to enable USB");
		return;
	}

	ring_buf_init(&ringbuf, sizeof(ring_buffer), ring_buffer);
	
	/* Wait 100ms for the host to do all settings */
	k_msleep(100);

	ret = uart_line_ctrl_get(usb_uart_dev, UART_LINE_CTRL_BAUD_RATE, &baudrate);
	if (ret) {
		printk("Failed to get baudrate, ret code %d", ret);
	} else {
		printk("Baudrate detected: %d", baudrate);
	}

	uart_irq_callback_set(usb_uart_dev, interrupt_handler);

	/* Enable rx interrupts */
	//uart_irq_rx_enable(usb_uart_dev);
}

void usb_uart_stop(void) {
    return;
}

void usb_uart_print_data_types(void) {
	usb_uart_print_message("print data types\n");

	snprintf(usb_uart_temp_str_buffer, USB_UART_TEMP_STR_BUFFER_SIZE, "char, min: %d, max: %d, nb bytes %d\n", CHAR_MIN, CHAR_MAX, sizeof(char));
	usb_uart_print_message(usb_uart_temp_str_buffer);
    
	snprintf(usb_uart_temp_str_buffer, USB_UART_TEMP_STR_BUFFER_SIZE, "int, min: %d, max: %d, nb bytes %d\n", INT_MIN, INT_MAX, sizeof(int));
	usb_uart_print_message(usb_uart_temp_str_buffer);
    
	snprintf(usb_uart_temp_str_buffer, USB_UART_TEMP_STR_BUFFER_SIZE, "long int, min: %ld, max: %ld, nb bytes %d\n", LONG_MIN, LONG_MAX, sizeof(long int));
	usb_uart_print_message(usb_uart_temp_str_buffer);
    
	//snprintf(usb_uart_temp_str_buffer, USB_UART_TEMP_STR_BUFFER_SIZE, "float, min: %f, max: %f, nb bytes %d\n", FLT_MIN, FLT_MAX, sizeof(float));
	//usb_uart_print_message(usb_uart_temp_str_buffer);

	snprintf(usb_uart_temp_str_buffer, USB_UART_TEMP_STR_BUFFER_SIZE, "int8_t, min: %d, max: %d, nb bytes %d\n", INT8_MIN, INT8_MAX, sizeof(int8_t));
	usb_uart_print_message(usb_uart_temp_str_buffer);

	snprintf(usb_uart_temp_str_buffer, USB_UART_TEMP_STR_BUFFER_SIZE, "uint8_t, min: %d, max: %d, nb bytes %d\n", 0, UINT8_MAX, sizeof(uint8_t));
	usb_uart_print_message(usb_uart_temp_str_buffer);

	snprintf(usb_uart_temp_str_buffer, USB_UART_TEMP_STR_BUFFER_SIZE, "uint16_t, min: %d, max: %d, nb bytes %d\n", 0, UINT16_MAX, sizeof(uint16_t));
	usb_uart_print_message(usb_uart_temp_str_buffer);
    
	snprintf(usb_uart_temp_str_buffer, USB_UART_TEMP_STR_BUFFER_SIZE, "uint32_t, min: %d, max: %ld, nb bytes %d\n", 0, UINT32_MAX, sizeof(uint32_t));
	usb_uart_print_message(usb_uart_temp_str_buffer);

	snprintf(usb_uart_temp_str_buffer, USB_UART_TEMP_STR_BUFFER_SIZE, "uint64_t, min: %d, max: %lld, nb bytes %d\n", 0, UINT64_MAX, sizeof(uint64_t));
	usb_uart_print_message(usb_uart_temp_str_buffer);

	return;
}

void usb_uart_print_message(char *msg) {
    if (!device_is_ready(usb_uart_dev)) {
        // error, device is not ready
        return;
    }
	int rb_len = 0;
    rb_len += ring_buf_put(&ringbuf, msg, strlen(msg));
    if (rb_len) {
        uart_irq_tx_enable(usb_uart_dev);
    }
    return;
}

static const char str_new_line_cr_lf[] = {0x0D, 0x0A, 0x00};
void usb_uart_print_adv_data(char* msg, char* addr_str, int8_t rssi, uint8_t *adv_data, uint16_t adv_len) {
    if (!device_is_ready(usb_uart_dev)) {
        // error, device is not ready
        return;
    }
	int rb_len = 0;
	
    rb_len += ring_buf_put(&ringbuf, msg, strlen(msg));
	rb_len += ring_buf_put(&ringbuf, addr_str, strlen(addr_str));
	snprintf(usb_uart_temp_str_buffer, USB_UART_TEMP_STR_BUFFER_SIZE, ", rssi: %02d, adv_data (hex, %02d):", rssi, adv_len);
	rb_len += ring_buf_put(&ringbuf, usb_uart_temp_str_buffer, strlen(usb_uart_temp_str_buffer));
	uint16_t n;
	for(n = 0; n < adv_len; n++) {
		snprintf(usb_uart_temp_str_buffer, USB_UART_TEMP_STR_BUFFER_SIZE, "%02X", adv_data[n]);
		rb_len += ring_buf_put(&ringbuf, usb_uart_temp_str_buffer, strlen(usb_uart_temp_str_buffer));
	}
	// add new line
	rb_len += ring_buf_put(&ringbuf, str_new_line_cr_lf, strlen(str_new_line_cr_lf));
    if (rb_len) {
        uart_irq_tx_enable(usb_uart_dev);
    }
}

void usb_uart_print_adv_data_timestamp(uint32_t now_s, uint32_t now_ms, char* msg, char* addr_str, int8_t rssi, uint8_t *adv_data, uint16_t adv_len) {
    if (!device_is_ready(usb_uart_dev)) {
        // error, device is not ready
        return;
    }
	int rb_len = 0;
	
	snprintf(usb_uart_temp_str_buffer, USB_UART_TEMP_STR_BUFFER_SIZE, "%d.%03d: ", now_s, now_ms);
	rb_len += ring_buf_put(&ringbuf, usb_uart_temp_str_buffer, strlen(usb_uart_temp_str_buffer));

	usb_uart_print_adv_data(msg, addr_str, rssi, adv_data, adv_len);
}
```

## src/usb_uart.h
```c
/**
 * Martin Egli
 * 2024-03-24
 * usb uart module
 */

#ifndef _USB_UART_H
#define _USB_UART_H

#include <stdint.h>

void usb_uart_start(void);
void usb_uart_stop(void);
void usb_uart_print_data_types(void);
void usb_uart_print_message(char *msg);
void usb_uart_print_adv_data(char* msg, char* addr_str, int8_t rssi, uint8_t *adv_data, uint16_t adv_len);
void usb_uart_print_adv_data_timestamp(uint32_t now_s, uint32_t now_ms, char* msg, char* addr_str, int8_t rssi, uint8_t *adv_data, uint16_t adv_len);

#endif // _USB_UART_H
```
