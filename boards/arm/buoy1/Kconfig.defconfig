## boards/arm/buoy1/Kconfig.defconfig
```kconfig
# Copyright (c) 2024 Nordic Semiconductor ASA
# SPDX-License-Identifier: Apache-2.0

if BOARD_BUOY1

config BOARD
	default "buoy1"

config BT_CTLR
   default BT


endif
```
